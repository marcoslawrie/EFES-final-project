/*
 * button.cpp
 *
 * Created: 15/2/2022 17:19:18
 *  Author: Marcos
 */ 

#include "button.h"
#include "../timer0/timer0.h"
#include "../incfile.h"




extern volatile uint8_t selection_flag;
extern uint16_t count_timer0;
extern volatile uint16_t PWM_duty_cycle;



void buttonsInit(void){
		
		///////////////////////////// INT 0 initialization ///////////////////////////////////////////
		//print_string_pooling("start int0\n",11); //Printing using polling
		DDRD  &= ~( 1UL << DDD2   );     /// Clear the PD2 pin and set PD2 (PCINT0 pin) now as input
		PORTD |=  ( 1UL << PORTD2);     /// Set PIN PD2 as INPUT with pull-up enabled

		EICRA |=  ( 1UL << ISC01 );     /// set INT0 to trigger on Falling edge
		EIFR |= (1UL <<INTF0);
		EIMSK |=  ( 1UL << INT0  );     /// Turns on INT0
		///////////////////////////// INT 1 initialization ///////////////////////////////////////////
		//print_string_pooling("start int1\n",11); //Printing using polling
		DDRD  &= ~( 1UL << DDD3   );     /// Clear the PD3 pin and set PD3 (PCINT1 pin) now as input
		PORTD |=  ( 1UL << PORTD3);     /// Set PIN PD3 as INPUT with pull-up enabled

		EICRA |=  ( 1UL << ISC11 );     /// set INT1 to trigger on Falling edge
		EIFR |= (1UL <<INTF1);
		EIMSK |=  ( 1UL << INT1  );     /// Turns on INT1
		
		//////////////////////////// Change interrupt initialization ///////////////////////////////
		DDRB &= ~(1UL << DDB0); //PB0 (PCINT0) in now an input
		PORTB |= (1 << PORTB0); // Pull-up enabled in PB0
		PCICR |= (1 << PCIE0);     // set PCIE0 to enable pin change interrupt 1
		PCMSK0 |= (1 << PCINT0);   // set PCINT0 to trigger an interrupt on state change
		PCIFR |= (1<<PCIF0); //clearing flag
		sei();                          /// turn on interrupts
		print_string_pooling("Buttons configuration end\n",26); //Printing using polling
}


ISR (PCINT0_vect){ //Interrupt using PIN 8 (PB0). It shows wave form stored in the memory using PWM
	
	if( count_timer0 == 0){ 
		count_timer0++;
		print_string_pooling("Analog signal output ON\n",26);//DEBUG
		selection_flag = ANALOG_OUTPUT_FLAG;
		timer0CTCInit(1024, 250);
	}
	else; //Do nothing, the interrupt was generated by a bounce         
}

ISR( INT1_vect ){ //Interrupt using PIN 3 (PD3). It starts filtering.
	
	if( count_timer0 == 0){ //count_timer0>55 ||
		print_string_pooling("Starting signal filtering\n",26);//DEBUG
		count_timer0++;
		timer0CTCInit(1024, 250);
		selection_flag = GENERATE_DATA_FLAG;
	}
	else; //Do nothing, the interrupt was generated by a bounce  
}

ISR ( INT0_vect ){ //Interrupt using PIN 2 (PD2). It turn on the PWM for power management and also read the analog value that sets the duty cycle.
	
	
	if( count_timer0 == 0){ 
		print_string_pooling("Setting power PWM output\n",25); //DEBUG
		count_timer0++;
		timer0CTCInit(1024, 155);
		selection_flag = POWER_PWM_FLAG;
		
	}
	else; //Do nothing, the interrupt was generated by a bounce
}
